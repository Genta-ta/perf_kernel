## ipc/Kconfig
```kconfig
config IPC_NS
	bool "IPC Namespaces"
	depends on NAMESPACES
	help
	  Support ipc namespaces. This allows containers to have
	  separate POSIX and System V IPC namespaces.
	  If unsure, say N.
```

## kernel/Kconfig
```kconfig
config UTS_NS
	bool "UTS Namespaces"
	depends on NAMESPACES
	help
	  Support UTS namespaces. This allows containers to have
	  their own hostname and domainname.
	  If unsure, say N.

config PID_NS
	bool "PID Namespaces"
	depends on NAMESPACES
	select PROC_FS
	help
	  Support process ID namespaces. This allows having multiple
	  processes with the same PID in different namespaces.
	  If unsure, say N.
```
